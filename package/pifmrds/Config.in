## package/pifmrds/Config.in
```kconfig
config BR2_PACKAGE_PIFMRDS
	bool "pifmrds"
	select BR2_PACKAGE_LIBSNDFILE
	help
	  FM-RDS transmitter using the Raspberry Pi GPIO

	  https://github.com/ChristopheJacquet/PiFmRds
```
